#include <OneWire.h>
#include <DallasTemperature.h>

#define ONE_WIRE_BUS 5
#define TEMPERATURE_PRECISION 9
#define MAX_THERMOMETERS 15

OneWire oneWire(ONE_WIRE_BUS);
DallasTemperature DS18B20(&oneWire);

// arrays to hold device addresses
DeviceAddress known_addresses[MAX_THERMOMETERS] = {
  { 0x28, 0xFF, 0xFE, 0x45, 0x90, 0x15, 0x04, 0x77 },
  { 0x28, 0xFF, 0x4D, 0x53, 0xA8, 0x15, 0x01, 0x83 },
  { 0x28, 0xFF, 0xD0, 0x2E, 0xA8, 0x15, 0x03, 0x51 },
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  { 0x28, 0xFF, 0x19, 0xD3, 0x03, 0x15, 0x02, 0x05 }
};

float temperature[MAX_THERMOMETERS] = {-127, -127, -127, -127, -127, -127, -127, -127, -127, -127, -127, -127, -127, -127, -127};

float getTemperature() {
  float temp;
  do {
    DS18B20.requestTemperatures(); 
    temp = DS18B20.getTempCByIndex(0);
    delay(100);
  } while (temp == 85.0 || temp == (-127.0));
  return temp;
}


void measure_setup() {
  DS18B20.begin();
  for (int i=0; i<DS18B20.getDeviceCount(); i++) {
    DeviceAddress address;
    if (!DS18B20.getAddress(address, i)) {
      Serial.println("Unable to find address for Device " + i);
    }
    DS18B20.setResolution(address, TEMPERATURE_PRECISION);
  }

}

void measure_loop() {
  DS18B20.requestTemperatures();
  for (int i=0; i<MAX_THERMOMETERS; i++) {
    DeviceAddress & addr = known_addresses[i];
    float temp = DS18B20.getTempC(addr);
    temperature[i] = temp;
  }
}

